## air_firmware_esp32s3_uvc/sdkconfig.defaults
```kconfig
# Flash size
CONFIG_ESPTOOLPY_FLASHSIZE_8MB=y

# CPU and SPIRAM
CONFIG_ESP32S3_DEFAULT_CPU_FREQ_240=y
CONFIG_ESP32S3_SPIRAM_SUPPORT=y
CONFIG_SPIRAM_MODE_OCT=y

# Cache optimization
CONFIG_ESP32S3_DATA_CACHE_64KB=y
CONFIG_ESP32S3_DATA_CACHE_8WAYS=y
CONFIG_ESP32S3_DATA_CACHE_LINE_64B=y

# Camera module
CONFIG_CAMERA_MODULE_ESP_S3_EYE=y

# ESP-IDF tool config
CONFIG_ESPTOOLPY_NO_STUB=y

# Console on UART (not USB, to free USB for UVC)
CONFIG_ESP_CONSOLE_UART_DEFAULT=y
CONFIG_ESP_CONSOLE_UART_NUM_0=y

# USB OTG peripheral enabled
CONFIG_SOC_USB_OTG_SUPPORTED=y

# FreeRTOS
CONFIG_FREERTOS_HZ=1000

# Logging level
CONFIG_LOG_DEFAULT_LEVEL_INFO=y

# Disable brownout detector for stable USB
CONFIG_ESP_BROWNOUT_DET=n

# Watchdog disabled for debugging
CONFIG_ESP_TASK_WDT_EN=n
```

## air_firmware_esp32s3eth/sdkconfig.defaults
```kconfig
CONFIG_ESPTOOLPY_FLASHSIZE_8MB=y

CONFIG_ESP32S3_DEFAULT_CPU_FREQ_240=y
CONFIG_ESP32S3_SPIRAM_SUPPORT=y

CONFIG_ESP32S3_DATA_CACHE_64KB=y
CONFIG_ESP32S3_DATA_CACHE_8WAYS=y
CONFIG_ESP32S3_DATA_CACHE_LINE_64B=y

CONFIG_BOARD_SELECT_BOARD_ESP32S3ETH=y
CONFIG_ESPTOOLPY_NO_STUB=y
CONFIG_ESP_CONSOLE_USB_SERIAL_JTAG=y

CONFIG_SPIRAM_MODE_OCT=y

CONFIG_ESP_WIFI_STATIC_RX_BUFFER_NUM=4
CONFIG_ESP_WIFI_DYNAMIC_RX_BUFFER_NUM=16
CONFIG_ESP_WIFI_STATIC_TX_BUFFER_NUM=4

#adds ~8kb RAM
CONFIG_ESP_WIFI_RX_IRAM_OPT=n

#can free ~6kb
#CONFIG_ESP_WIFI_IRAM_OPT=n

# Ethernet settings
CONFIG_ETH_USE_SPI_ETHERNET=y
CONFIG_ETH_SPI_ETHERNET_KSZ8863=n
CONFIG_ETH_SPI_ETHERNET_DM9051=n
CONFIG_ETH_SPI_ETHERNET_W5500=y
CONFIG_ETH_SPI_DEFAULT_CONFIG=y
CONFIG_ETH_DMA_BUFFER_SIZE=512
CONFIG_ETH_DMA_RX_BUFFER_NUM=10
CONFIG_ETH_DMA_TX_BUFFER_NUM=10
CONFIG_ETH_RMII_CLK_INPUT=y
CONFIG_ETH_RMII_CLK_IN_GPIO=0

# SPI settings for SD card
CONFIG_SPI_MASTER_ENABLED=y
```

## esp32-c6-wifi-transmitter/sdkconfig.defaults
```kconfig
# ESP32-C6 WiFi Transmitter Configuration

# Target configuration
CONFIG_IDF_TARGET="esp32c6"

# WiFi configuration
CONFIG_ESP_WIFI_STATIC_RX_BUFFER_NUM=16
CONFIG_ESP_WIFI_DYNAMIC_RX_BUFFER_NUM=64
CONFIG_ESP_WIFI_DYNAMIC_TX_BUFFER_NUM=64
CONFIG_ESP_WIFI_AMPDU_TX_ENABLED=y
CONFIG_ESP_WIFI_AMPDU_RX_ENABLED=y
CONFIG_ESP_WIFI_AMSDU_TX_ENABLED=y
CONFIG_ESP_WIFI_RX_BA_WIN=32
CONFIG_ESP_WIFI_IRAM_OPT=y
CONFIG_ESP_WIFI_RX_IRAM_OPT=y
CONFIG_ESP_WIFI_ENABLE_WPA3_SAE=y
CONFIG_ESP_WIFI_ENABLE_WPA3_OWE_STA=y

# WiFi 6 (802.11ax) support
CONFIG_ESP_WIFI_ENABLE_WIFI_TX_STATS=y
CONFIG_ESP_WIFI_ENABLE_WIFI_RX_STATS=y

# SPI configuration for IPC
CONFIG_SPI_SLAVE_ISR_IN_IRAM=y

# FreeRTOS configuration
CONFIG_FREERTOS_HZ=1000
CONFIG_FREERTOS_UNICORE=n

# System configuration
CONFIG_ESP_SYSTEM_EVENT_QUEUE_SIZE=64
CONFIG_ESP_SYSTEM_EVENT_TASK_STACK_SIZE=4096

# Log level
CONFIG_LOG_DEFAULT_LEVEL_INFO=y
CONFIG_LOG_MAXIMUM_LEVEL_VERBOSE=y

# Performance optimizations
CONFIG_COMPILER_OPTIMIZATION_PERF=y
CONFIG_ESPTOOLPY_FLASHSIZE_4MB=y
CONFIG_PARTITION_TABLE_CUSTOM_FILENAME="partitions.csv"
CONFIG_PARTITION_TABLE_FILENAME="partitions.csv"
```

## esp32-gs/main/Kconfig.projbuild
```kconfig
menu "ESP32 FPV Ground Station Configuration"

    config FPV_GS_DEFAULT_CHANNEL
        int "Default WiFi channel"
        default 7
        range 1 14
        help
            Default WiFi channel for FPV reception and AP.

    config FPV_GS_DEFAULT_AP_SSID
        string "Default AP SSID"
        default "ESP32-FPV-GS"
        help
            Default SSID for the ground station access point.

    config FPV_GS_DEFAULT_AP_PASS
        string "Default AP Password"
        default "fpvground"
        help
            Default password for the ground station access point.
            Must be at least 8 characters.

    config FPV_GS_MAX_STA_CONN
        int "Maximum AP connections"
        default 2
        range 1 4
        help
            Maximum number of stations that can connect to the AP.

    config FPV_GS_FRAME_BUFFER_COUNT
        int "Frame buffer count"
        default 2
        range 2 5
        help
            Number of frame buffers in the ring buffer.
            Use 2 without PSRAM, 3-5 with PSRAM.

    config FPV_GS_MAX_FRAME_SIZE
        int "Maximum frame size (bytes)"
        default 49152
        range 16384 131072
        help
            Maximum size of a single JPEG frame.
            48KB balances frame size vs memory for WiFi crypto.
            Use 64KB+ with PSRAM.

    config FPV_GS_PACKET_QUEUE_SIZE
        int "Packet queue size"
        default 32
        range 16 64
        help
            Size of the packet processing queue.

    config FPV_GS_FEC_K
        int "FEC K value (data packets per block)"
        default 6
        range 1 12
        help
            Number of primary data packets per FEC block.

    config FPV_GS_FEC_N
        int "FEC N value (total packets per block)"
        default 12
        range 2 24
        help
            Total number of packets per FEC block (K data + N-K parity).

    menu "Network Interface Selection"

        config FPV_GS_ENABLE_USB_NET
            bool "Enable USB Network (NCM)"
            default n
            help
                Enable USB networking using NCM protocol.
                The device appears as a USB network adapter on the host PC.
                Default IP: 192.168.4.1 (configurable via usb-netif component).
                Requires USB-OTG port (not USB-Serial/JTAG).
                Note: USB Serial/JTAG must be disabled in sdkconfig.

        config FPV_GS_ENABLE_WIFI_AP
            bool "Enable WiFi Access Point"
            default y
            help
                Enable WiFi access point for wireless web interface access.
                Promiscuous packet capture is always enabled regardless.
                Disable to save memory when using USB-only mode.

    endmenu

    menu "USB UVC (USB Camera) Configuration"

        config FPV_GS_ENABLE_USB_UVC
            bool "Enable USB UVC (USB Webcam)"
            default y
            help
                Enable USB Video Class (UVC) device mode.
                The ESP32-S3 appears as a USB webcam to the host PC/Android.
                Can be used with standard camera apps (VLC, OBS, etc.).
                Runtime switching between UVC and NCM modes is supported.

        config FPV_GS_UVC_WIDTH
            int "UVC Frame Width"
            default 640
            range 320 1280
            depends on FPV_GS_ENABLE_USB_UVC
            help
                Default width for UVC video frames.
                Common values: 320, 480, 640, 800, 1280
                Higher resolutions require more bandwidth.

        config FPV_GS_UVC_HEIGHT
            int "UVC Frame Height"
            default 480
            range 240 720
            depends on FPV_GS_ENABLE_USB_UVC
            help
                Default height for UVC video frames.
                Common values: 240, 320, 360, 456, 480, 720
                Higher resolutions require more bandwidth.

        config FPV_GS_UVC_FPS
            int "UVC Frame Rate"
            default 15
            range 5 30
            depends on FPV_GS_ENABLE_USB_UVC
            help
                Target frame rate for UVC streaming.
                Actual FPS depends on incoming video and USB bandwidth.
                15 FPS is recommended for 640x480.

        config FPV_GS_UVC_BULK_MODE
            bool "Use Bulk Transfer Mode (experimental)"
            default n
            depends on FPV_GS_ENABLE_USB_UVC
            help
                Use bulk transfer instead of isochronous for UVC.
                Bulk mode offers higher throughput (~1.2 MB/s vs ~512 KB/s)
                but may have compatibility issues on some Linux systems.
                Default (isochronous) is recommended for better compatibility.

                IMPORTANT: This option alone is not sufficient. You must also set
                CONFIG_UVC_CAM1_XFER_MODE=1 in sdkconfig.defaults for bulk mode.
                Use the provided sdkconfig.defaults.bulk file for bulk mode builds:
                  cp sdkconfig.defaults.bulk sdkconfig.defaults && idf.py build

        config FPV_GS_UVC_DEFAULT_ACTIVE
            bool "UVC active by default (NCM inactive)"
            default n
            depends on FPV_GS_ENABLE_USB_UVC && FPV_GS_ENABLE_USB_NET
            help
                If both UVC and NCM are enabled, this selects which one
                is active by default at boot. Can be switched at runtime.
                If disabled, NCM is active by default.

    endmenu

endmenu
```

## esp32-s3-android-receiver/sdkconfig.defaults
```kconfig
# ESP32-S3 Android WiFi Receiver Configuration

# Target configuration
CONFIG_IDF_TARGET="esp32s3"

# WiFi configuration - Monitor mode and reception
CONFIG_ESP_WIFI_STATIC_RX_BUFFER_NUM=32
CONFIG_ESP_WIFI_DYNAMIC_RX_BUFFER_NUM=128
CONFIG_ESP_WIFI_DYNAMIC_TX_BUFFER_NUM=16
CONFIG_ESP_WIFI_AMPDU_RX_ENABLED=y
CONFIG_ESP_WIFI_RX_BA_WIN=64
CONFIG_ESP_WIFI_IRAM_OPT=y
CONFIG_ESP_WIFI_RX_IRAM_OPT=y
CONFIG_ESP_WIFI_ENABLE_WPA3_SAE=n
CONFIG_ESP_WIFI_ENABLE_WPA3_OWE_STA=n

# WiFi statistics for monitoring
CONFIG_ESP_WIFI_ENABLE_WIFI_RX_STATS=y
CONFIG_ESP_WIFI_ENABLE_WIFI_TX_STATS=n

# USB configuration for Android connectivity
CONFIG_TINYUSB_ENABLED=y
CONFIG_TINYUSB_CDC_ENABLED=y
CONFIG_TINYUSB_CDC_RX_BUFSIZE=512
CONFIG_TINYUSB_CDC_TX_BUFSIZE=512
CONFIG_TINYUSB_MSC_ENABLED=n
CONFIG_TINYUSB_HID_ENABLED=n

# USB OTG configuration
CONFIG_ESP_USB_OTG_SUPPORTED=y
CONFIG_USB_OTG_SUPPORTED=y

# FreeRTOS configuration
CONFIG_FREERTOS_HZ=1000
CONFIG_FREERTOS_UNICORE=n
CONFIG_FREERTOS_USE_TRACE_FACILITY=y
CONFIG_FREERTOS_USE_STATS_FORMATTING_FUNCTIONS=y

# Memory configuration - Optimized for high throughput
CONFIG_ESP_SYSTEM_EVENT_QUEUE_SIZE=64
CONFIG_ESP_SYSTEM_EVENT_TASK_STACK_SIZE=4096

# SPIRAM configuration for buffering
CONFIG_SPIRAM=y
CONFIG_SPIRAM_MODE_OCT=y
CONFIG_SPIRAM_SPEED_80M=y
CONFIG_SPIRAM_USE_MALLOC=y
CONFIG_SPIRAM_MALLOC_ALWAYSINTERNAL=16384

# Log level
CONFIG_LOG_DEFAULT_LEVEL_INFO=y
CONFIG_LOG_MAXIMUM_LEVEL_VERBOSE=y

# Performance optimizations
CONFIG_COMPILER_OPTIMIZATION_PERF=y
CONFIG_ESPTOOLPY_FLASHSIZE_8MB=y

# Partition table
CONFIG_PARTITION_TABLE_CUSTOM_FILENAME="partitions.csv"
CONFIG_PARTITION_TABLE_FILENAME="partitions.csv"

# Task watchdog
CONFIG_ESP_TASK_WDT_TIMEOUT_S=10
CONFIG_ESP_TASK_WDT_CHECK_IDLE_TASK_CPU0=n
CONFIG_ESP_TASK_WDT_CHECK_IDLE_TASK_CPU1=n
```

## gs_firmware_esp32s3/sdkconfig.defaults
```kconfig
# ESP32-S3 Ground Station Configuration

# Target
CONFIG_IDF_TARGET="esp32s3"

# CPU
CONFIG_ESP_DEFAULT_CPU_FREQ_MHZ_240=y
CONFIG_ESP_DEFAULT_CPU_FREQ_MHZ=240

# PSRAM
CONFIG_ESP32S3_SPIRAM_SUPPORT=y
CONFIG_SPIRAM=y
CONFIG_SPIRAM_MODE_OCT=y
CONFIG_SPIRAM_SPEED_80M=y
CONFIG_SPIRAM_BOOT_INIT=y
CONFIG_SPIRAM_MALLOC_ALWAYSINTERNAL=16384
CONFIG_SPIRAM_TRY_ALLOCATE_WIFI_LWIP=y
CONFIG_SPIRAM_MALLOC_RESERVE_INTERNAL=32768

# WiFi
CONFIG_ESP32_WIFI_STATIC_RX_BUFFER_NUM=16
CONFIG_ESP32_WIFI_DYNAMIC_RX_BUFFER_NUM=64
CONFIG_ESP32_WIFI_RX_BA_WIN=32
CONFIG_ESP_WIFI_ENABLE_WPA3_SAE=n

# USB
CONFIG_TINYUSB_CDC_ENABLED=n
CONFIG_TINYUSB_MSC_ENABLED=n
CONFIG_TINYUSB_NET_ENABLED=y
CONFIG_TINYUSB_NET_MODE_NCM=y

# HTTP Server
CONFIG_HTTPD_MAX_REQ_HDR_LEN=1024
CONFIG_HTTPD_MAX_URI_LEN=512
CONFIG_HTTPD_WS_SUPPORT=y

# lwIP
CONFIG_LWIP_LOCAL_HOSTNAME="esp32-fpv-gs"
CONFIG_LWIP_SO_RCVBUF=y
CONFIG_LWIP_TCP_SND_BUF_DEFAULT=32768
CONFIG_LWIP_TCP_WND_DEFAULT=32768
CONFIG_LWIP_TCPIP_RECVMBOX_SIZE=64
CONFIG_LWIP_DHCPS=y
CONFIG_LWIP_DHCPS_MAX_STATION_NUM=4

# FreeRTOS
CONFIG_FREERTOS_HZ=1000
CONFIG_FREERTOS_TIMER_TASK_STACK_DEPTH=3072

# Partition
CONFIG_PARTITION_TABLE_CUSTOM=y
CONFIG_PARTITION_TABLE_CUSTOM_FILENAME="partitions.csv"

# Logging
CONFIG_LOG_DEFAULT_LEVEL_INFO=y
CONFIG_LOG_MAXIMUM_LEVEL_VERBOSE=y

# Compiler
CONFIG_COMPILER_OPTIMIZATION_PERF=y
```
